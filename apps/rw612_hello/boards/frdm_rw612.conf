## apps/spi_lis3dh/dts/bindings/st,testsen.yaml
```yaml
# Copyright (c) 2018 STMicroelectronics
# SPDX-License-Identifier: Apache-2.0

description: |
    STMicroelectronics LIS2DH 3-axis accelerometer accessed through SPI bus

compatible: "st,lis3dh-custom"

include: ["spi-device.yaml"]
```

## boards/fanke/fk750m5_xbh6/Kconfig.fk750m5_xbh6
```kconfig
# Copyright (c) 2024 zack jiang, Honbo He <hehongbo918@gmail.com>
# SPDX-License-Identifier: Apache-2.0

config BOARD_FK750M5_XBH6
	select SOC_STM32H750XX
```

## boards/fanke/fk750m5_xbh6/board.yml
```yaml
board:
  name: fk750m5_xbh6
  full_name: FK750M5-XBH6
  vendor: fanke
  socs:
    - name: stm32h750xx
```

## boards/fanke/fk750m6_xih6/board.yml
```yaml
board:
  name: fk750m6_xih6
  full_name: FK750M6-XIH6
  vendor: fanke
  socs:
    - name: stm32h743xx
```

## boards/ruiside/art_pi22/board.yml
```yaml
board:
  name: art_pi22
  full_name: ART-Pi22
  vendor: ruiside
  socs:
    - name: stm32h7r7xx
```

## boards/ruiside/stm32f407_rt_spark/Kconfig.stm32f407_rt_spark
```kconfig
# Copyright The Zephyr Project Contributors
# SPDX-License-Identifier: Apache-2.0

config BOARD_STM32F407_RT_SPARK
	select SOC_STM32F407XG
```

## boards/ruiside/stm32f407_rt_spark/board.yml
```yaml
board:
  name: stm32f407_rt_spark
  full_name: STM32F407 RT SPARK
  vendor: ruiside
  socs:
    - name: stm32f407xx
```

## boards/sifli/huangshan_pi_sf32lb52_ulp/Kconfig.huangshan_pi_sf32lb52_ulp
```kconfig
# SPDX-FileCopyrightText: Copyright The Zephyr Project Contributors
# SPDX-License-Identifier: Apache-2.0

config BOARD_HUANGSHAN_PI_SF32LB52_ULP
	select SOC_SF32LB525UC6
```

## boards/sifli/huangshan_pi_sf32lb52_ulp/board.yml
```yaml
# SPDX-FileCopyrightText: Copyright The Zephyr Project Contributors
# SPDX-License-Identifier: Apache-2.0

board:
  name: huangshan_pi_sf32lb52_ulp
  full_name: HuangShan PI SF32LB52-ULP
  vendor: sifli
  socs:
    - name: sf32lb525uc6
```

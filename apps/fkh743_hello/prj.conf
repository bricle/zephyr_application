## prj.conf
```kconfig
CONFIG_STDOUT_CONSOLE=y
# CONFIG_FLASH=y
# CONFIG_SPI=y
CONFIG_PRINTK=y
CONFIG_SHELL=y
CONFIG_I2C=y
CONFIG_I2C_SHELL=y
CONFIG_LOG=y
# CONFIG_FLASH_SHELL=y
# CONFIG_FLASH_SHELL_TEST_COMMANDS=y
# # CONFIG_FLASH_SHELL_BUFFER_SIZE=0x10000
# CONFIG_FLASH_JESD216_API=y
# CONFIG_STM32_MEMMAP=y

# CONFIG_FILE_SYSTEM=y
# CONFIG_ZMS=y
# CONFIG_SETTINGS=y
CONFIG_CACHE_MANAGEMENT=y
CONFIG_MEMC=y

CONFIG_DISPLAY=y
CONFIG_HEAP_MEM_POOL_SIZE=81920

CONFIG_MEMC=y
# CONFIG_STM32_LTDC_RGB565=y
# CONFIG_DISPLAY_INIT_PRIORITY=87
# CONFIG_STM32_LTDC_DISABLE_FMC_BANK1=y
# CONFIG_INPUT_GT911_INTERRUPT=y
# CONFIG_STM32_LTDC_FB_USE_SHARED_MULTI_HEAP=y
CONFIG_LVGL=y
CONFIG_LV_USE_LOG=y
CONFIG_LV_USE_LABEL=y
CONFIG_LV_USE_ARC=y
CONFIG_LV_USE_MONKEY=y
CONFIG_LV_FONT_MONTSERRAT_14=y
CONFIG_LV_Z_MEM_POOL_SIZE=16384
CONFIG_LV_Z_SHELL=y
CONFIG_MAIN_STACK_SIZE=10240

CONFIG_DISPLAY=y
CONFIG_DISPLAY_LOG_LEVEL_ERR=y
CONFIG_INPUT=y
# CONFIG_LV_Z_POINTER_INPUT=y
# CONFIG_INPUT_EVENT_DUMP=y
CONFIG_LV_USE_DRAW_DMA2D=y
CONFIG_LV_LOG_LEVEL_TRACE=y
CONFIG_LV_USE_SYSMON=y

# CONFIG_INPUT_LOG_LEVEL_DBG=y# CONFIG_LV_USE_PROFILER=y

CONFIG_INPUT_EVENT_DUMP=y


CONFIG_LV_Z_MEM_POOL_SIZE=16384
CONFIG_LV_Z_SHELL=y
CONFIG_MAIN_STACK_SIZE=4096

CONFIG_DISPLAY=y
CONFIG_DISPLAY_LOG_LEVEL_ERR=y

CONFIG_LOG=y
CONFIG_SHELL=y

CONFIG_LVGL=y
CONFIG_LV_USE_LOG=y
CONFIG_LV_USE_LABEL=y
CONFIG_LV_USE_ARC=y
CONFIG_LV_USE_MONKEY=y
CONFIG_LV_FONT_MONTSERRAT_14=y
CONFIG_LV_Z_POINTER_INPUT_MSGQ_COUNT=15
CONFIG_INPUT_LOG_LEVEL_DBG=y
CONFIG_LV_Z_FLUSH_THREAD=y
CONFIG_LV_CONF_SKIP=n
CONFIG_LV_Z_FLUSH_THREAD_STACK_SIZE=4096
CONFIG_LV_Z_POINTER_INPUT=y
CONFIG_INPUT=y
CONFIG_INPUT_GT911_INTERRUPT=y
```

## src/main.c
```c
/*
 * Copyright (c) 2018 Jan Van Winkel <jan.van_winkel@dxplore.eu>
 *
 * SPDX-License-Identifier: Apache-2.0
 */

#include <zephyr/device.h>
#include <zephyr/devicetree.h>
#include <zephyr/drivers/display.h>
#include <zephyr/drivers/gpio.h>
#include <lvgl.h>
#include <stdio.h>
#include <string.h>
#include <zephyr/kernel.h>
#include <lvgl_input_device.h>

#define LOG_LEVEL CONFIG_LOG_DEFAULT_LEVEL
#include <zephyr/logging/log.h>
LOG_MODULE_REGISTER(app);

static uint32_t count;

#ifdef CONFIG_RESET_COUNTER_SW0
static struct gpio_dt_spec button_gpio = GPIO_DT_SPEC_GET_OR(DT_ALIAS(sw0), gpios, {0});
static struct gpio_callback button_callback;

static void
button_isr_callback(const struct device* port, struct gpio_callback* cb, uint32_t pins) {
    ARG_UNUSED(port);
    ARG_UNUSED(cb);
    ARG_UNUSED(pins);

    count = 0;
}
#endif /* CONFIG_RESET_COUNTER_SW0 */

#ifdef CONFIG_LV_Z_ENCODER_INPUT
static const struct device* lvgl_encoder = DEVICE_DT_GET(
    DT_COMPAT_GET_ANY_STATUS_OKAY(zephyr_lvgl_encoder_input));
#endif /* CONFIG_LV_Z_ENCODER_INPUT */

#ifdef CONFIG_LV_Z_KEYPAD_INPUT
static const struct device* lvgl_keypad = DEVICE_DT_GET(
    DT_COMPAT_GET_ANY_STATUS_OKAY(zephyr_lvgl_keypad_input));
#endif /* CONFIG_LV_Z_KEYPAD_INPUT */

static void lv_btn_click_callback(lv_event_t* e) {
    ARG_UNUSED(e);
    LOG_INF("...Button clicked");

    count = 0;
}

int main(void) {
    char count_str[11] = {0};
    const struct device* display_dev;
    lv_obj_t* hello_world_label;
    lv_obj_t* count_label;

    display_dev = DEVICE_DT_GET(DT_CHOSEN(zephyr_display));
    if (!device_is_ready(display_dev)) {
        LOG_ERR("Device not ready, aborting test");
        return 0;
    }

#ifdef CONFIG_RESET_COUNTER_SW0
    if (gpio_is_ready_dt(&button_gpio)) {
        int err;

        err = gpio_pin_configure_dt(&button_gpio, GPIO_INPUT);
        if (err) {
            LOG_ERR("failed to configure button gpio: %d", err);
            return 0;
        }

        gpio_init_callback(&button_callback, button_isr_callback, BIT(button_gpio.pin));

        err = gpio_add_callback(button_gpio.port, &button_callback);
        if (err) {
            LOG_ERR("failed to add button callback: %d", err);
            return 0;
        }

        err = gpio_pin_interrupt_configure_dt(&button_gpio, GPIO_INT_EDGE_TO_ACTIVE);
        if (err) {
            LOG_ERR("failed to enable button callback: %d", err);
            return 0;
        }
    }
#endif /* CONFIG_RESET_COUNTER_SW0 */

#ifdef CONFIG_LV_Z_ENCODER_INPUT
    lv_obj_t* arc;
    lv_group_t* arc_group;

    arc = lv_arc_create(lv_screen_active());
    lv_obj_align(arc, LV_ALIGN_CENTER, 0, -15);
    lv_obj_set_size(arc, 150, 150);

    arc_group = lv_group_create();
    lv_group_add_obj(arc_group, arc);
    lv_indev_set_group(lvgl_input_get_indev(lvgl_encoder), arc_group);
#endif /* CONFIG_LV_Z_ENCODER_INPUT */

#ifdef CONFIG_LV_Z_KEYPAD_INPUT
    lv_obj_t* btn_matrix;
    lv_group_t* btn_matrix_group;
    static const char* const btnm_map[] = {"1", "2", "3", "4", ""};

    btn_matrix = lv_buttonmatrix_create(lv_screen_active());
    lv_obj_align(btn_matrix, LV_ALIGN_CENTER, 0, 70);
    lv_buttonmatrix_set_map(btn_matrix, (const char**)btnm_map);
    lv_obj_set_size(btn_matrix, 100, 50);

    btn_matrix_group = lv_group_create();
    lv_group_add_obj(btn_matrix_group, btn_matrix);
    lv_indev_set_group(lvgl_input_get_indev(lvgl_keypad), btn_matrix_group);
#endif /* CONFIG_LV_Z_KEYPAD_INPUT */

    if (IS_ENABLED(CONFIG_LV_Z_POINTER_INPUT)) {
        lv_obj_t* hello_world_button;
        LOG_INF("lv pointer input");
        hello_world_button = lv_button_create(lv_screen_active());
        lv_obj_align(hello_world_button, LV_ALIGN_CENTER, 0, -15);
        lv_obj_add_event_cb(hello_world_button, lv_btn_click_callback, LV_EVENT_CLICKED, NULL);
        hello_world_label = lv_label_create(hello_world_button);
    } else {
        hello_world_label = lv_label_create(lv_screen_active());
    }

    lv_label_set_text(hello_world_label, "Hello world!");
    lv_obj_align(hello_world_label, LV_ALIGN_CENTER, 0, 0);

    count_label = lv_label_create(lv_screen_active());
    lv_obj_align(count_label, LV_ALIGN_BOTTOM_MID, 0, 0);

    lv_timer_handler();
    // display_blanking_off(display_dev);

    while (1) {
        if ((count % 100) == 0U) {
            sprintf(count_str, "%d", count / 100U);
            lv_label_set_text(count_label, count_str);
        }
        lv_timer_handler();
        ++count;
        k_sleep(K_MSEC(10));
    }
}
```

## CMakeLists.txt
```
# SPDX-License-Identifier: Apache-2.0

cmake_minimum_required(VERSION 3.20.0)

find_package(Zephyr REQUIRED HINTS $ENV{ZEPHYR_BASE})
project(funpack_dwm3001cdk)

target_sources(app PRIVATE 
src/main.c 
src/my_lbs.c
src/bh1750_sensor.c
src/led_strip.c
)
zephyr_library_include_directories(.)
set(BOARD_FLASH_RUNNER jlink)
```

## prj.conf
```kconfig
#
# Copyright (c) 2018 Nordic Semiconductor
#
# SPDX-License-Identifier: LicenseRef-Nordic-5-Clause
#

# Logger module
CONFIG_LOG=y
# CONFIG_LOG_DEFAULT_LEVEL=4
# Button and LED library
CONFIG_DK_LIBRARY=y
# Floating Point Unit
# CONFIG_FPU=y
# Bluetooth LE
# STEP 1 - Include the Bluetooth LE stack in your project
CONFIG_BT=y
# STEP 2 - Set the Bluetooth LE device name
CONFIG_BT_DEVICE_NAME="FUNPACK_DWM3001CDK"

# Increase stack size for the main thread and System Workqueue
CONFIG_SYSTEM_WORKQUEUE_STACK_SIZE=2048
CONFIG_MAIN_STACK_SIZE=4096

CONFIG_BT_PERIPHERAL=y
# CONFIG_SHIELD_SSD1306_128X64=y



CONFIG_I2C=y
CONFIG_I2C_SHELL=y
CONFIG_SHELL=y
CONFIG_SHELL_BACKEND_SERIAL=y
CONFIG_SSD1306=y


CONFIG_HEAP_MEM_POOL_SIZE=16384
CONFIG_DISPLAY=y

CONFIG_CFB_LOG_LEVEL_DBG=y
CONFIG_CHARACTER_FRAMEBUFFER=y


CONFIG_LED_STRIP=y
CONFIG_LED_STRIP_LOG_LEVEL_DBG=y
CONFIG_SOC_NRF52832_ALLOW_SPIM_DESPITE_PAN_58=y


CONFIG_SENSOR=y
```

## src/main.c
```c
#include <stdint.h>
#include <zephyr/kernel.h>
#include <zephyr/logging/log.h>
#include <zephyr/bluetooth/bluetooth.h>
#include <zephyr/bluetooth/gap.h>
#include <zephyr/bluetooth/uuid.h>
#include <zephyr/bluetooth/addr.h>
#include <dk_buttons_and_leds.h>
#include "zephyr/bluetooth/conn.h"
#include <zephyr/drivers/display.h>
#include <zephyr/display/cfb.h>
#include <zephyr/drivers/led_strip.h>
#include <zephyr/drivers/sensor.h>
#include <stdio.h>
#include "my_lbs.h"
#include "led_strip.h"
LOG_MODULE_REGISTER(FUNPACK_DWM3001CDK, LOG_LEVEL_INF);
#define COMPANY_ID_CODE 0x0059

#define DEVICE_NAME     CONFIG_BT_DEVICE_NAME
#define DEVICE_NAME_LEN (sizeof(DEVICE_NAME) - 1)

#define RUN_STATUS_LED         DK_LED4
#define RUN_LED_BLINK_INTERVAL 1000
#define CONNECTION_STATUS_LED  DK_LED2
#define LBS_LED                DK_LED1
#define USER_BUTTON            DK_BTN1_MSK

#define DISPLAY_BUFFER_PITCH 128
struct bt_conn* default_conn        = NULL;
static const struct bt_le_adv_param* adv_param = BT_LE_ADV_PARAM(BT_LE_ADV_OPT_CONN
                                                                     | BT_LE_ADV_OPT_USE_IDENTITY,
                                                                 BT_GAP_ADV_FAST_INT_MIN_1,
                                                                 BT_GAP_ADV_FAST_INT_MIN_1,
                                                                 NULL);

typedef struct {
    uint16_t company_id;
    uint16_t number_pressed;
} adv_mfg_data_t;

static adv_mfg_data_t adv_mfg_data = {
    .company_id     = COMPANY_ID_CODE,
    .number_pressed = 0,
};
static const struct bt_data ad[] = {
    BT_DATA_BYTES(BT_DATA_FLAGS, BT_LE_AD_GENERAL | BT_LE_AD_NO_BREDR),
    BT_DATA(BT_DATA_NAME_COMPLETE, DEVICE_NAME, DEVICE_NAME_LEN),
    BT_DATA(BT_DATA_MANUFACTURER_DATA, (uint8_t*)&adv_mfg_data, sizeof(adv_mfg_data)),

};

static const struct bt_data sd[] = {

    BT_DATA_BYTES(BT_DATA_UUID128_ALL,
                  BT_UUID_128_ENCODE(0x00001523, 0x1212, 0xefde, 0x1523, 0x785feabcd123)),
};

void on_connected(struct bt_conn* conn, uint8_t err) {
    if (err) {
        LOG_ERR("Failed to connect (err %d)\n", err);
        return;
    }
    LOG_INF("...Connected\n");
    default_conn = bt_conn_ref(conn);
    dk_set_led_on(CONNECTION_STATUS_LED);
    struct bt_conn_info info;
    bt_conn_get_info(default_conn, &info);
    LOG_INF("Connected to %02x:%02x:%02x:%02x:%02x:%02x\n",
            info.le.dst->a.val[5],
            info.le.dst->a.val[4],
            info.le.dst->a.val[3],
            info.le.dst->a.val[2],
            info.le.dst->a.val[1],
            info.le.dst->a.val[0]);
    double coon_intvl = info.le.interval * 1.25;
    uint16_t spv_tmo  = info.le.timeout * 10;
    LOG_INF("coon parameter: interval: %.2f ms; latency %d intervals, timeout %d ms",
            coon_intvl,
            info.le.latency,
            spv_tmo);
}

void on_disconnected(struct bt_conn* conn, uint8_t reason) {
    dk_set_led_off(CONNECTION_STATUS_LED);
    if (default_conn) {
        bt_conn_unref(default_conn);
        default_conn = NULL;
    }
    LOG_INF("Disconnected (reason %u)\n", reason);
}

struct bt_conn_cb conn_callbacks = {
    .connected    = on_connected,
    .disconnected = on_disconnected,

};
static uint32_t user_button_state;

static void button_changed(uint32_t button_state, uint32_t has_changed) {
    int err;
    bool btn_ched = (has_changed & USER_BUTTON) ? true : false;
    bool btn_pred = (button_state & USER_BUTTON) ? true : false;
    if (btn_ched) {
        LOG_INF("Button %s\n", btn_pred ? "pressed" : "released");
        user_button_state = button_state & USER_BUTTON;
        my_lbs_sent_btn_indi(user_button_state);
    }
}

static int init_button(void) {
    int err;

    err = dk_buttons_init(button_changed);
    if (err) {
        printk("Cannot init buttons (err: %d)\n", err);
    }

    return err;
}

bool btn_cb(void) {
    return dk_get_buttons() & USER_BUTTON;
}

void led_cb(const bool led_state) {
    if (led_state) {
        dk_set_led_on(LBS_LED);
    } else {
        dk_set_led_off(LBS_LED);
    }
}
struct bt_lbs_cb lbs_cb = {
    .led_write                = led_cb,
    .button_read              = btn_cb,
    .led_strip_display_number = led_strip_display_number,
};
const struct device* display;
int main(void) {
    int blink_status = 0;
    int err;

    LOG_INF("Starting Lesson 2 - Exercise 1 \n");

    err = dk_leds_init();
    if (err) {
        LOG_ERR("LEDs init failed (err %d)\n", err);
        return -1;
    }

    err = init_button();
    if (err) {

        LOG_ERR("Button init failed (err %d)\n", err);
        return -1;
    }
    my_lbs_init(&lbs_cb);

    bt_addr_le_t addr;
    err = bt_addr_le_from_str("FF:EE:DD:CC:BB:AA", "random", &addr);
    if (err < 0) {
        LOG_ERR("Failed to parse address (err %d)\n", err);
        return -1;
    }
    err = bt_id_create(&addr, NULL);
    if (err < 0) {
        LOG_ERR("Failed to create identity (err %d)\n", err);
        return -1;
    }
    err = bt_conn_cb_register(&conn_callbacks);
    if (err < 0) {
        LOG_ERR("Failed to register connection callbacks (err %d)\n", err);
        return -1;
    }
    err = bt_enable(NULL);
    if (err < 0) {
        LOG_ERR("Bluetooth init failed (err %d)\n", err);
        return -1;
    }

    LOG_INF("Bluetooth initialized\n");

    err = bt_le_adv_start(adv_param, ad, ARRAY_SIZE(ad), sd, ARRAY_SIZE(sd));
    if (err) {
        LOG_ERR("Advertising failed to start (err %d)\n", err);
        return -1;
    }

    LOG_INF("Advertising successfully started\n");

    display = DEVICE_DT_GET(DT_CHOSEN(zephyr_display));
    if (display == NULL) {
        LOG_ERR("device pointer is NULL");
        return -1;
    }

    if (!device_is_ready(display)) {
        LOG_ERR("display device is not ready");
        return -1;
    }
    err = cfb_framebuffer_init(display);
    if (err < 0) {
        LOG_ERR("Framebuffer initialization failed");
        return -1;
    }
    err = cfb_print(display, "hello world", 0, 0);
    if (err < 0) {
        LOG_ERR("cfb_print failed");
        return -1;
    }
    err = cfb_framebuffer_invert(display);
    err = cfb_framebuffer_finalize(display);
    if (err < 0) {
        LOG_ERR("Framebuffer finalization failed");
        return -1;
    }
    led_strip_init();
    led_strip_set_char_spacing(1);
    led_strip_scroll_text("Hello, world!", SCROLL_LEFT);
    for (;;) {
        led_strip_scroll_update();
        k_msleep(200);
    }
}
```

## src/bh1750_sensor.c
```c
#include <stdint.h>
#include <zephyr/kernel.h>
#include <zephyr/logging/log.h>
#include <zephyr/bluetooth/bluetooth.h>
#include <zephyr/bluetooth/gap.h>
#include <zephyr/bluetooth/uuid.h>
#include <zephyr/bluetooth/addr.h>
#include <dk_buttons_and_leds.h>
#include <zephyr/drivers/display.h>
#include <zephyr/display/cfb.h>
#include <zephyr/drivers/led_strip.h>
#include <zephyr/drivers/sensor.h>
#include "my_lbs.h"
#include "bh1750_sensor.h"
LOG_MODULE_REGISTER(BH1750_SENSOR, LOG_LEVEL_INF);
#define STACKSIZE 1024
#define PRIORITY  7
static uint32_t app_sensor_value = 100;

static const struct device* get_bh1750_device(void) {
    const struct device* const dev = DEVICE_DT_GET_ANY(rohm_bh1750);

    if (dev == NULL) {
        // No such node, or the node does not have status "okay".
        LOG_ERR("no device found");
        return NULL;
    }

    if (!device_is_ready(dev)) {
        LOG_ERR("Device \"%s\" is not ready; "
                "check the driver initialization logs for errors.",
                dev->name);
        return NULL;
    }

    LOG_INF("Found device \"%s\", getting sensor data\n", dev->name);
    return dev;
}

void bh1750_thread(void) {
    const struct device* bh1750_dev = get_bh1750_device();
    struct sensor_value light;

    while (1) {

        LOG_INF("Fetching sensor data");

        sensor_sample_fetch(bh1750_dev);

        LOG_INF("Fetching sensor data done");

        sensor_channel_get(bh1750_dev, SENSOR_CHAN_ALL, &light);
        printk("Light: %d.%06d\n", light.val1, light.val2);
        my_lbs_send_sensor_notify(light.val1);
        k_sleep(K_MSEC(2000));
    }
}

K_THREAD_DEFINE(bh1750_thread_id, STACKSIZE, bh1750_thread, NULL, NULL, NULL, PRIORITY, 0, 0);
```

## src/bh1750_sensor.h
```c
#ifndef BH1750_SENSOR_H_
#define BH1750_SENSOR_H_

#endif // BH1750_SENSOR_H_
```

## src/led_strip.c
```c
#include <stdint.h>
#include <zephyr/kernel.h>
#include <zephyr/logging/log.h>
#include <zephyr/drivers/led_strip.h>
#include <string.h>
#include "numbers.h"
#include "led_strip.h"

LOG_MODULE_REGISTER(LED_STRIP, LOG_LEVEL_INF);

#define STRIP_NODE DT_ALIAS(led_strip)

#if DT_NODE_HAS_PROP(DT_ALIAS(led_strip), chain_length)
#define STRIP_NUM_PIXELS DT_PROP(DT_ALIAS(led_strip), chain_length)
#else
#error Unable to determine length of LED strip
#endif

#define LED_MATRIX_SIZE   8
#define NUM_PIXELS        (LED_MATRIX_SIZE * LED_MATRIX_SIZE)
#define MAX_STRING_LENGTH 100

// LED像素缓冲区
static struct led_rgb pixels[STRIP_NUM_PIXELS];
static const struct device* const strip = DEVICE_DT_GET(STRIP_NODE);

// 滚动显示相关变量
static uint8_t scroll_buffer[MAX_STRING_LENGTH * LED_MATRIX_SIZE * 2][LED_MATRIX_SIZE];
static int scroll_buffer_width              = 0;
static int original_width                   = 0;
static int scroll_position                  = 0;
static bool scroll_running                  = false;
static scroll_direction_t current_direction = SCROLL_LEFT;

// 获取LED矩阵中LED的索引
#define LED_INDEX(row, col) ((row) * LED_MATRIX_SIZE + (col))

static void clear_display(struct led_rgb* pixels) {
    const struct led_rgb color_off = LED_COLOR_OFF;
    for (int i = 0; i < STRIP_NUM_PIXELS; i++) {
        pixels[i] = color_off;
    }
}

static void update_display() {
    int ret = led_strip_update_rgb(strip, pixels, STRIP_NUM_PIXELS);
    if (ret) {
        printk("Failed to update strip: %d\n", ret);
    }
}

// 添加字符间距配置
static uint8_t char_spacing = 2; // 默认间距为2个像素

// 设置字符间距的函数
void led_strip_set_char_spacing(uint8_t spacing) {
    char_spacing = spacing;
}
// 准备字符串的滚动缓冲区
#define TEXT_GAP 4 // 两遍文本之间的间距

static void prepare_scroll_buffer(const char* str) {
    int str_len = strlen(str);
    memset(scroll_buffer, 0, sizeof(scroll_buffer));
    scroll_buffer_width = 0;
    original_width      = 0;

    // 第一遍复制
    for (int i = 0; i < str_len; i++) {
        char c = str[i];
        if (c < 0 || c > 127) {
            continue;
        }

        uint8_t char_width = CHAR_WIDTHS[c];

        // 复制字符到缓冲区
        for (int row = 0; row < 7; row++) {
            for (int col = 0; col < char_width; col++) {
                scroll_buffer[scroll_buffer_width + col][row + 1] = ASCII_CHARS[c][row][col];
            }
        }
        scroll_buffer_width += char_width;

        // 在每个字符后添加间距
        if (i < str_len - 1) {
            // 添加空白间距
            for (int space = 0; space < char_spacing; space++) {
                for (int row = 0; row < LED_MATRIX_SIZE; row++) {
                    scroll_buffer[scroll_buffer_width + space][row] = 0;
                }
            }
            scroll_buffer_width += char_spacing;
        }
    }

    // 保存原始宽度（包括将要添加的间距）
    original_width = scroll_buffer_width + TEXT_GAP;

    // 添加文本间的间距
    scroll_buffer_width += TEXT_GAP;

    // 第二遍复制
    for (int i = 0; i < str_len; i++) {
        char c = str[i];
        if (c < 0 || c > 127) {
            continue;
        }

        uint8_t char_width = CHAR_WIDTHS[c];

        for (int row = 0; row < 7; row++) {
            for (int col = 0; col < char_width; col++) {
                scroll_buffer[scroll_buffer_width + col][row + 1] = ASCII_CHARS[c][row][col];
            }
        }
        scroll_buffer_width += char_width;

        if (i < str_len - 1) {
            scroll_buffer_width += char_spacing;
        }
    }
}

void led_strip_scroll_text(const char* str, scroll_direction_t direction) {
    if (!device_is_ready(strip)) {
        LOG_ERR("LED strip device is not ready");
        return;
    }

    current_direction = direction;
    scroll_running    = true;
    scroll_position   = 0; // 总是从0开始，因为我们有两份完整的文本

    prepare_scroll_buffer(str);
}

void led_strip_scroll_update() {
    if (!scroll_running) {
        return;
    }

    const struct led_rgb color_on  = LED_COLOR_WHITE;
    const struct led_rgb color_off = LED_COLOR_OFF;

    // 清除显示
    clear_display(pixels);

    // 更新显示内容
    for (int row = 0; row < LED_MATRIX_SIZE; row++) {
        for (int col = 0; col < LED_MATRIX_SIZE; col++) {
            int buffer_x = scroll_position + col;
            if (buffer_x >= 0 && buffer_x < scroll_buffer_width) {
                int idx     = LED_INDEX(row, col);
                pixels[idx] = scroll_buffer[buffer_x][row] ? color_on : color_off;
            }
        }
    }

    // 更新LED显示
    update_display();

    // 更新滚动位置
    if (current_direction == SCROLL_LEFT) {
        scroll_position++;
        // 当第一遍文本滚动完成后，回到第二遍文本的开始位置
        if (scroll_position >= original_width) {
            scroll_position = 0;
        }
    } else {
        scroll_position--;
        // 当滚动到开始位置时，跳转到第一遍文本的末尾
        if (scroll_position < 0) {
            scroll_position = original_width - 1;
        }
    }
}

void led_strip_stop_scroll() {
    scroll_running = false;
    clear_display(pixels);
    update_display();
}

int led_strip_init() {
    if (!device_is_ready(strip)) {
        LOG_ERR("LED strip device %s is not ready", strip->name);
        return -1;
    }

    LOG_INF("LED strip initialized successfully");
    clear_display(pixels);
    update_display();
    return 0;
}

void led_strip_display_number(uint8_t number) {
    if (number > 9) {
        return;
    }

    char str[2] = {number + '0', '\0'};
    led_strip_scroll_text(str, SCROLL_LEFT);
}
```

## src/led_strip.h
```c
#ifndef LED_STRIP_H_
#define LED_STRIP_H_

// 滚动方向枚举
typedef enum { SCROLL_LEFT, SCROLL_RIGHT } scroll_direction_t;

// 初始化LED条
int led_strip_init(void);

// 开始滚动显示文本
void led_strip_scroll_text(const char* str, scroll_direction_t direction);

// 更新滚动显示（需要在主循环中定期调用）
void led_strip_scroll_update(void);
void led_strip_set_char_spacing(uint8_t spacing);
// 停止滚动显示
void led_strip_stop_scroll(void);

// 保持向后兼容的数字显示功能
void led_strip_display_number(uint8_t number);

#endif // LED_STRIP_H_
```

## src/logo.h
```c
#ifndef LOGO_H_
#define LOGO_H_

uint8_t buf[1024] = {
0x00, 0x00, 0x00, 0x00, 0x00, 0x00, 0x00, 0x00, 0x00, 0x00, 0x00, 0x00, 0x00, 0x00, 0x00, 0x00, 
0x00, 0x00, 0x00, 0x00, 0x00, 0x00, 0x00, 0x00, 0x00, 0x00, 0x00, 0x00, 0x00, 0x00, 0x00, 0x00, 
0x00, 0x00, 0x00, 0x00, 0x00, 0x00, 0x00, 0x00, 0x00, 0x00, 0x00, 0x00, 0x00, 0x00, 0x00, 0x00, 
0x00, 0x00, 0x00, 0x00, 0x00, 0x00, 0x00, 0x00, 0x00, 0x00, 0x00, 0x80, 0x80, 0x80, 0x80, 0x00, 
0x00, 0x80, 0x80, 0x80, 0x80, 0x00, 0x00, 0x00, 0x00, 0x00, 0x00, 0x00, 0x00, 0x00, 0x00, 0x00, 
0x00, 0x00, 0x00, 0x00, 0x00, 0x00, 0x00, 0x00, 0x00, 0x00, 0x00, 0x00, 0x00, 0x00, 0x00, 0x00, 
0x00, 0x00, 0x00, 0x00, 0x00, 0x00, 0x00, 0x00, 0x00, 0x00, 0x00, 0x00, 0x00, 0x00, 0x00, 0x00, 
0x00, 0x00, 0x00, 0x00, 0x00, 0x00, 0x00, 0x00, 0x00, 0x00, 0x00, 0x00, 0x00, 0x00, 0x00, 0x00, 
0x00, 0x00, 0x00, 0x00, 0x00, 0x00, 0x00, 0x00, 0x00, 0x00, 0x00, 0x00, 0x00, 0x00, 0x00, 0x00, 
0x00, 0x00, 0x00, 0x00, 0x00, 0x00, 0x00, 0x00, 0x00, 0x00, 0x00, 0x00, 0x00, 0x00, 0x00, 0x00, 
0x00, 0x00, 0x00, 0x00, 0x00, 0x00, 0x00, 0x00, 0x00, 0x00, 0x00, 0x00, 0x00, 0x00, 0x00, 0x80, 
0xc0, 0xe0, 0xf0, 0xf8, 0xfc, 0xfc, 0xfe, 0xfe, 0xff, 0xff, 0xff, 0x1f, 0x1f, 0x0f, 0x0f, 0x00, 
0x00, 0x0f, 0x0f, 0x1f, 0x1f, 0xff, 0xff, 0xff, 0xfe, 0xfe, 0xfc, 0xfc, 0xf8, 0xf0, 0xe0, 0xc0, 
0x80, 0x00, 0x00, 0x00, 0x00, 0x00, 0x00, 0x00, 0x00, 0x00, 0x00, 0x00, 0x00, 0x00, 0x00, 0x00, 
0x00, 0x00, 0x00, 0x00, 0x00, 0x00, 0x00, 0x00, 0x00, 0x00, 0x00, 0x00, 0x00, 0x00, 0x00, 0x00, 
0x00, 0x00, 0x00, 0x00, 0x00, 0x00, 0x00, 0x00, 0x00, 0x00, 0x00, 0x00, 0x00, 0x00, 0x00, 0x00, 
0x00, 0x00, 0x00, 0x00, 0x00, 0x00, 0x00, 0x00, 0x00, 0x00, 0x00, 0x00, 0x00, 0x00, 0x00, 0x00, 
0x00, 0x00, 0x00, 0x00, 0x00, 0x00, 0x00, 0x00, 0x00, 0x00, 0x00, 0x00, 0x00, 0x00, 0x00, 0x00, 
0x00, 0x00, 0x00, 0x00, 0x00, 0x00, 0x00, 0x00, 0x00, 0x00, 0x00, 0x00, 0xc0, 0xf8, 0xfe, 0xff, 
0xff, 0xff, 0xff, 0xff, 0xff, 0xff, 0xff, 0xff, 0xff, 0xff, 0xff, 0x86, 0x86, 0x86, 0x86, 0x86, 
0x86, 0x86, 0x86, 0x86, 0x86, 0xff, 0xff, 0xff, 0xff, 0xff, 0xff, 0xff, 0xff, 0xff, 0xff, 0xff, 
0xff, 0xfe, 0xf8, 0xc0, 0x00, 0x00, 0x00, 0x00, 0x00, 0x00, 0x00, 0x00, 0x00, 0x00, 0x00, 0x00, 
0x00, 0x00, 0x00, 0x00, 0x00, 0x00, 0x00, 0x00, 0x00, 0x00, 0x00, 0x00, 0x00, 0x00, 0x00, 0x00, 
0x00, 0x00, 0x00, 0x00, 0x00, 0x00, 0x00, 0x00, 0x00, 0x00, 0x00, 0x00, 0x00, 0x00, 0x00, 0x00, 
0x00, 0x00, 0x00, 0x00, 0x00, 0x00, 0x00, 0x00, 0x00, 0x00, 0x00, 0x00, 0x00, 0x00, 0x00, 0x00, 
0x00, 0x00, 0x00, 0x00, 0x00, 0x00, 0x00, 0x00, 0x00, 0x00, 0x00, 0x00, 0x00, 0x00, 0x00, 0x00, 
0x00, 0x00, 0x00, 0x00, 0x00, 0x00, 0x00, 0x00, 0x00, 0x00, 0x00, 0x00, 0xff, 0xff, 0xff, 0xff, 
0xff, 0xff, 0xff, 0xff, 0xff, 0xff, 0xff, 0xff, 0xff, 0xff, 0xff, 0x21, 0x21, 0x21, 0x21, 0x21, 
0x21, 0x21, 0x21, 0x21, 0x21, 0xff, 0xff, 0xff, 0xff, 0xff, 0xff, 0xff, 0xff, 0xff, 0xff, 0xff, 
0xff, 0xff, 0xff, 0xff, 0x00, 0x00, 0x00, 0x00, 0x00, 0x00, 0x00, 0x00, 0x00, 0x00, 0x00, 0x00, 
0x00, 0x00, 0x00, 0x00, 0x00, 0x00, 0x00, 0x00, 0x00, 0x00, 0x00, 0x00, 0x00, 0x00, 0x00, 0x00, 
0x00, 0x00, 0x00, 0x00, 0x00, 0x00, 0x00, 0x00, 0x00, 0x00, 0x00, 0x00, 0x00, 0x00, 0x00, 0x00, 
0x00, 0x00, 0x00, 0x00, 0x00, 0x00, 0x00, 0x00, 0x00, 0x00, 0x00, 0x00, 0x00, 0x00, 0x00, 0x00, 
0x00, 0x00, 0x00, 0x00, 0x00, 0x00, 0x00, 0x00, 0x00, 0x00, 0x00, 0x00, 0x00, 0x00, 0x00, 0x00, 
0x00, 0x00, 0x00, 0x00, 0x00, 0x00, 0x00, 0x00, 0x00, 0x00, 0x00, 0x00, 0x00, 0x07, 0x1f, 0x7f, 
0xff, 0xff, 0xff, 0xff, 0xff, 0xff, 0xff, 0xff, 0xff, 0xff, 0xff, 0x18, 0x18, 0x18, 0x18, 0x18, 
0x18, 0x18, 0x18, 0x18, 0x18, 0xff, 0xff, 0xff, 0xff, 0xff, 0xff, 0xff, 0xff, 0xff, 0xff, 0xff, 
0x7f, 0x1f, 0x07, 0x00, 0x00, 0x00, 0x00, 0x00, 0x00, 0x00, 0x00, 0x00, 0x00, 0x00, 0x00, 0x00, 
0x00, 0x00, 0x00, 0x00, 0x00, 0x00, 0x00, 0x00, 0x00, 0x00, 0x00, 0x00, 0x00, 0x00, 0x00, 0x00, 
0x00, 0x00, 0x00, 0x00, 0x00, 0x00, 0x00, 0x00, 0x00, 0x00, 0x00, 0x00, 0x00, 0x00, 0x00, 0x00, 
0x00, 0x00, 0x00, 0x00, 0x00, 0x00, 0x00, 0x00, 0x00, 0x00, 0x00, 0x00, 0x00, 0x00, 0x00, 0x00, 
0x00, 0x00, 0x00, 0x00, 0x00, 0x00, 0x00, 0x00, 0x00, 0x00, 0x00, 0x00, 0x00, 0x00, 0x00, 0x00, 
0x00, 0x00, 0x00, 0x00, 0x00, 0x00, 0x00, 0x00, 0x00, 0x00, 0x00, 0x00, 0x00, 0x00, 0x00, 0x00, 
0x00, 0x01, 0x03, 0x07, 0x0f, 0x0f, 0x1f, 0x1f, 0x3f, 0x3f, 0x3f, 0x7e, 0x7e, 0x7c, 0x7c, 0x00, 
0x00, 0x7c, 0x7c, 0x7e, 0x7e, 0x3f, 0x3f, 0x3f, 0x1f, 0x1f, 0x0f, 0x0f, 0x07, 0x03, 0x01, 0x00, 
0x00, 0x00, 0x00, 0x00, 0x00, 0x00, 0x00, 0x00, 0x00, 0x00, 0x00, 0x00, 0x00, 0x00, 0x00, 0x00, 
0x00, 0x00, 0x00, 0x00, 0x00, 0x00, 0x00, 0x00, 0x00, 0x00, 0x00, 0x00, 0x00, 0x00, 0x00, 0x00, 
0x00, 0x00, 0x00, 0x00, 0x00, 0x00, 0x00, 0x00, 0x00, 0x00, 0x00, 0x00, 0x00, 0x00, 0x00, 0x00, 
0x00, 0x00, 0x00, 0x00, 0x00, 0x00, 0x00, 0x00, 0x00, 0x00, 0x00, 0x00, 0x10, 0x10, 0xf0, 0x10, 
0x10, 0x00, 0xf0, 0x80, 0x80, 0x80, 0xf0, 0x00, 0xf0, 0x90, 0x90, 0x90, 0x10, 0x00, 0x00, 0x00, 
0xf0, 0x90, 0x90, 0x90, 0x60, 0x00, 0xf0, 0x00, 0x00, 0x00, 0xf0, 0x00, 0xf0, 0x00, 0x00, 0x00, 
0x00, 0x00, 0xf0, 0x00, 0x00, 0x00, 0x00, 0x80, 0x80, 0x80, 0x00, 0xf0, 0x00, 0x00, 0x00, 0xf0, 
0x00, 0xf0, 0x90, 0x90, 0x90, 0x60, 0x00, 0x00, 0x00, 0xf0, 0x90, 0x90, 0x90, 0x60, 0x00, 0xf0, 
0x90, 0x90, 0x10, 0x10, 0x00, 0x60, 0x90, 0x90, 0x90, 0x10, 0x00, 0xf0, 0x00, 0x60, 0x90, 0x90, 
0x90, 0x10, 0x00, 0x10, 0x10, 0xf0, 0x10, 0x10, 0x00, 0xe0, 0x10, 0x10, 0x10, 0xe0, 0x00, 0xf0, 
0x90, 0x90, 0x90, 0x60, 0x00, 0x00, 0x00, 0x00, 0x00, 0x00, 0x00, 0x00, 0x00, 0x00, 0x00, 0x00, 
0x00, 0x00, 0x00, 0x00, 0x00, 0x00, 0x00, 0x00, 0x00, 0x00, 0x00, 0x00, 0x00, 0x00, 0x07, 0x00, 
0x00, 0x00, 0x07, 0x00, 0x00, 0x00, 0x07, 0x00, 0x07, 0x04, 0x04, 0x04, 0x04, 0x00, 0x00, 0x00, 
0x07, 0x00, 0x00, 0x00, 0x00, 0x00, 0x03, 0x04, 0x04, 0x04, 0x03, 0x00, 0x07, 0x04, 0x04, 0x04, 
0x04, 0x00, 0x07, 0x04, 0x04, 0x04, 0x04, 0x00, 0x00, 0x00, 0x00, 0x03, 0x04, 0x04, 0x04, 0x03, 
0x00, 0x07, 0x00, 0x00, 0x00, 0x00, 0x00, 0x00, 0x00, 0x07, 0x00, 0x00, 0x01, 0x06, 0x00, 0x07, 
0x04, 0x04, 0x04, 0x04, 0x00, 0x04, 0x04, 0x04, 0x04, 0x03, 0x00, 0x07, 0x00, 0x04, 0x04, 0x04, 
0x04, 0x03, 0x00, 0x00, 0x00, 0x07, 0x00, 0x00, 0x00, 0x03, 0x04, 0x04, 0x04, 0x03, 0x00, 0x07, 
0x00, 0x00, 0x01, 0x06, 0x00, 0x00, 0x00, 0x00, 0x00, 0x00, 0x00, 0x00, 0x00, 0x00, 0x00, 0x00};

#endif // LOGO_H_
```

## src/numbers.h
```c
#ifndef NUMBERS_H
#define NUMBERS_H
#include <zephyr/drivers/led_strip.h>

#define CONFIG_SAMPLE_LED_BRIGHTNESS   25
#define CONFIG_SAMPLE_LED_UPDATE_DELAY 100

// 定义RGB颜色
#define LED_COLOR_WHITE {.r = 35, .g = 23, .b = 37}
#define LED_COLOR_OFF   {.r = 0, .g = 0, .b = 0}

// 为每个字符定义实际宽度
static const uint8_t CHAR_WIDTHS[128] = {
    [' '] = 2,                                  // 空格
    ['!'] = 2, [','] = 2, ['.'] = 1, ['?'] = 4, // 标点符号
    ['-'] = 3, ['+'] = 3, [':'] = 1, [';'] = 2, ['('] = 2,  [')'] = 2, ['['] = 2,  [']'] = 2,
    ['<'] = 3, ['>'] = 3, ['='] = 3, ['*'] = 3, ['\''] = 1, ['"'] = 3, ['\\'] = 3, ['/'] = 3,
    ['0'] = 4, ['1'] = 3, ['2'] = 4, ['3'] = 4, ['4'] = 4,  ['5'] = 4, ['6'] = 4,  ['7'] = 4,
    ['8'] = 4, ['9'] = 4, ['A'] = 4, ['B'] = 4, ['C'] = 4,  ['D'] = 4, ['E'] = 4,  ['F'] = 4,
    ['G'] = 4, ['H'] = 4, ['I'] = 3, ['J'] = 4, ['K'] = 4,  ['L'] = 4, ['M'] = 5,  ['N'] = 4,
    ['O'] = 4, ['P'] = 4, ['Q'] = 4, ['R'] = 4, ['S'] = 4,  ['T'] = 3, ['U'] = 4,  ['V'] = 4,
    ['W'] = 5, ['X'] = 4, ['Y'] = 4, ['Z'] = 4, ['a'] = 4,  ['b'] = 4, ['c'] = 3,  ['d'] = 4,
    ['e'] = 4, ['f'] = 3, ['g'] = 4, ['h'] = 4, ['i'] = 1,  ['j'] = 2, ['k'] = 3,  ['l'] = 3,
    ['m'] = 5, ['n'] = 4, ['o'] = 4, ['p'] = 4, ['q'] = 4,  ['r'] = 3, ['s'] = 4,  ['t'] = 4,
    ['u'] = 4, ['v'] = 3, ['w'] = 5, ['x'] = 3, ['y'] = 3,  ['z'] = 3};

// ASCII字符的点阵字库(原有大写字母和数字保持不变,新增内容如下)
static const uint8_t ASCII_CHARS[128][7][5] = {
    // ... (保持原有的空格、数字0-9和大写字母A-Z不变)
    [' '] =
        {// 空格
         {0, 0},
               {0, 0},
               {0, 0},
               {0, 0},
               {0, 0},
               {0, 0},
               {0, 0}         },
    ['0'] =
        {// 数字0
         {1, 1, 1, 1},
               {1, 0, 0, 1},
               {1, 0, 0, 1},
               {1, 0, 0, 1},
               {1, 0, 0, 1},
               {1, 0, 0, 1},
               {1, 1, 1, 1}   },
    ['1'] =
        {// 数字1
         {0, 1, 1, 0},
               {0, 0, 1, 0},
               {0, 0, 1, 0},
               {0, 0, 1, 0},
               {0, 0, 1, 0},
               {0, 0, 1, 0},
               {1, 1, 1, 0}   },
    ['2'] =
        {// 数字2
         {1, 1, 1, 1},
               {0, 0, 0, 1},
               {0, 0, 0, 1},
               {1, 1, 1, 1},
               {1, 0, 0, 0},
               {1, 0, 0, 0},
               {1, 1, 1, 1}   },
    ['3'] =
        {// 数字3
         {1, 1, 1, 1},
               {0, 0, 0, 1},
               {0, 0, 0, 1},
               {0, 1, 1, 1},
               {0, 0, 0, 1},
               {0, 0, 0, 1},
               {1, 1, 1, 1}   },
    ['4'] =
        {// 数字4
         {1, 0, 0, 1},
               {1, 0, 0, 1},
               {1, 0, 0, 1},
               {1, 1, 1, 1},
               {0, 0, 0, 1},
               {0, 0, 0, 1},
               {0, 0, 0, 1}   },
    ['5'] =
        {// 数字5
         {1, 1, 1, 1},
               {1, 0, 0, 0},
               {1, 0, 0, 0},
               {1, 1, 1, 1},
               {0, 0, 0, 1},
               {0, 0, 0, 1},
               {1, 1, 1, 1}   },
    ['6'] =
        {// 数字6
         {1, 1, 1, 1},
               {1, 0, 0, 0},
               {1, 0, 0, 0},
               {1, 1, 1, 1},
               {1, 0, 0, 1},
               {1, 0, 0, 1},
               {1, 1, 1, 1}   },
    ['7'] =
        {// 数字7
         {1, 1, 1, 1},
               {0, 0, 0, 1},
               {0, 0, 1, 0},
               {0, 1, 0, 0},
               {0, 1, 0, 0},
               {0, 1, 0, 0},
               {0, 1, 0, 0}   },
    ['8'] =
        {// 数字8
         {1, 1, 1, 1},
               {1, 0, 0, 1},
               {1, 0, 0, 1},
               {1, 1, 1, 1},
               {1, 0, 0, 1},
               {1, 0, 0, 1},
               {1, 1, 1, 1}   },
    ['9'] =
        {// 数字9
         {1, 1, 1, 1},
               {1, 0, 0, 1},
               {1, 0, 0, 1},
               {1, 1, 1, 1},
               {0, 0, 0, 1},
               {0, 0, 0, 1},
               {1, 1, 1, 1}   },
    ['A'] =
        {// 字母A
         {0, 1, 1, 0},
               {1, 0, 0, 1},
               {1, 0, 0, 1},
               {1, 1, 1, 1},
               {1, 0, 0, 1},
               {1, 0, 0, 1},
               {1, 0, 0, 1}   },
    ['B'] =
        {// 字母B
         {1, 1, 1, 0},
               {1, 0, 0, 1},
               {1, 0, 0, 1},
               {1, 1, 1, 0},
               {1, 0, 0, 1},
               {1, 0, 0, 1},
               {1, 1, 1, 0}   },
    ['C'] =
        {// 字母C
         {0, 1, 1, 1},
               {1, 0, 0, 0},
               {1, 0, 0, 0},
               {1, 0, 0, 0},
               {1, 0, 0, 0},
               {1, 0, 0, 0},
               {0, 1, 1, 1}   },
    ['D'] =
        {// 字母D
         {1, 1, 1, 0},
               {1, 0, 0, 1},
               {1, 0, 0, 1},
               {1, 0, 0, 1},
               {1, 0, 0, 1},
               {1, 0, 0, 1},
               {1, 1, 1, 0}   },
    ['E'] =
        {// 字母E
         {1, 1, 1, 1},
               {1, 0, 0, 0},
               {1, 0, 0, 0},
               {1, 1, 1, 0},
               {1, 0, 0, 0},
               {1, 0, 0, 0},
               {1, 1, 1, 1}   },
    ['F'] =
        {// 字母F
         {1, 1, 1, 1},
               {1, 0, 0, 0},
               {1, 0, 0, 0},
               {1, 1, 1, 0},
               {1, 0, 0, 0},
               {1, 0, 0, 0},
               {1, 0, 0, 0}   },
    ['G'] =
        {// 字母G
         {0, 1, 1, 1},
               {1, 0, 0, 0},
               {1, 0, 0, 0},
               {1, 0, 1, 1},
               {1, 0, 0, 1},
               {1, 0, 0, 1},
               {0, 1, 1, 1}   },
    ['H'] =
        {// 字母H
         {1, 0, 0, 1},
               {1, 0, 0, 1},
               {1, 0, 0, 1},
               {1, 1, 1, 1},
               {1, 0, 0, 1},
               {1, 0, 0, 1},
               {1, 0, 0, 1}   },
    ['I'] =
        {// 字母I
         {1, 1, 1},
               {0, 1, 0},
               {0, 1, 0},
               {0, 1, 0},
               {0, 1, 0},
               {0, 1, 0},
               {1, 1, 1}      },
    ['J'] =
        {// 字母J
         {0, 1, 1, 1},
               {0, 0, 1, 0},
               {0, 0, 1, 0},
               {0, 0, 1, 0},
               {0, 0, 1, 0},
               {1, 0, 1, 0},
               {0, 1, 0, 0}   },
    ['K'] =
        {// 字母K
         {1, 0, 0, 1},
               {1, 0, 1, 0},
               {1, 1, 0, 0},
               {1, 1, 0, 0},
               {1, 0, 1, 0},
               {1, 0, 0, 1},
               {1, 0, 0, 1}   },
    ['L'] =
        {// 字母L
         {1, 0, 0, 0},
               {1, 0, 0, 0},
               {1, 0, 0, 0},
               {1, 0, 0, 0},
               {1, 0, 0, 0},
               {1, 0, 0, 0},
               {1, 1, 1, 1}   },
    ['M'] =
        {// 字母M
         {1, 0, 0, 0, 1},
               {1, 1, 0, 1, 1},
               {1, 0, 1, 0, 1},
               {1, 0, 0, 0, 1},
               {1, 0, 0, 0, 1},
               {1, 0, 0, 0, 1},
               {1, 0, 0, 0, 1}},
    ['N'] =
        {// 字母N
         {1, 0, 0, 1},
               {1, 1, 0, 1},
               {1, 0, 1, 1},
               {1, 0, 0, 1},
               {1, 0, 0, 1},
               {1, 0, 0, 1},
               {1, 0, 0, 1}   },
    ['O'] =
        {// 字母O
         {0, 1, 1, 0},
               {1, 0, 0, 1},
               {1, 0, 0, 1},
               {1, 0, 0, 1},
               {1, 0, 0, 1},
               {1, 0, 0, 1},
               {0, 1, 1, 0}   },
    ['P'] =
        {// 字母P
         {1, 1, 1, 1},
               {1, 0, 0, 1},
               {1, 0, 0, 1},
               {1, 1, 1, 1},
               {1, 0, 0, 0},
               {1, 0, 0, 0},
               {1, 0, 0, 0}   },
    ['Q'] =
        {// 字母Q
         {0, 1, 1, 0},
               {1, 0, 0, 1},
               {1, 0, 0, 1},
               {1, 0, 0, 1},
               {1, 0, 1, 1},
               {0, 1, 1, 0},
               {0, 0, 0, 1}   },
    ['R'] =
        {// 字母R
         {1, 1, 1, 0},
               {1, 0, 0, 1},
               {1, 0, 0, 1},
               {1, 1, 1, 0},
               {1, 0, 1, 0},
               {1, 0, 0, 1},
               {1, 0, 0, 1}   },
    ['S'] =
        {// 字母S
         {0, 1, 1, 1},
               {1, 0, 0, 0},
               {1, 0, 0, 0},
               {0, 1, 1, 0},
               {0, 0, 0, 1},
               {0, 0, 0, 1},
               {1, 1, 1, 0}   },
    ['T'] =
        {// 字母T
         {1, 1, 1},
               {0, 1, 0},
               {0, 1, 0},
               {0, 1, 0},
               {0, 1, 0},
               {0, 1, 0},
               {0, 1, 0}      },
    ['U'] =
        {// 字母U
         {1, 0, 0, 1},
               {1, 0, 0, 1},
               {1, 0, 0, 1},
               {1, 0, 0, 1},
               {1, 0, 0, 1},
               {1, 0, 0, 1},
               {0, 1, 1, 0}   },
    ['V'] =
        {// 字母V
         {1, 0, 0, 1},
               {1, 0, 0, 1},
               {1, 0, 0, 1},
               {1, 0, 0, 1},
               {1, 0, 0, 1},
               {0, 1, 1, 0},
               {0, 1, 1, 0}   },
    ['W'] =
        {// 字母W
         {1, 0, 0, 0, 1},
               {1, 0, 0, 0, 1},
               {1, 0, 0, 0, 1},
               {1, 0, 1, 0, 1},
               {1, 0, 1, 0, 1},
               {1, 1, 0, 1, 1},
               {1, 0, 0, 0, 1}},
    ['X'] =
        {// 字母X
         {1, 0, 0, 1},
               {1, 0, 0, 1},
               {0, 1, 1, 0},
               {0, 1, 1, 0},
               {0, 1, 1, 0},
               {1, 0, 0, 1},
               {1, 0, 0, 1}   },
    ['Y'] =
        {// 字母Y
         {1, 0, 0, 1},
               {1, 0, 0, 1},
               {0, 1, 1, 0},
               {0, 1, 1, 0},
               {0, 1, 0, 0},
               {0, 1, 0, 0},
               {0, 1, 0, 0}   },
    ['Z'] =
        {// 字母Z
         {1, 1, 1, 1},
               {0, 0, 0, 1},
               {0, 0, 1, 0},
               {0, 1, 0, 0},
               {1, 0, 0, 0},
               {1, 0, 0, 0},
               {1, 1, 1, 1}   },
    // 小写字母a-z
    ['a'] =
        {// 小写a
         {0, 0, 0, 0},
               {0, 0, 0, 0},
               {0, 1, 1, 0},
               {0, 0, 0, 1},
               {0, 1, 1, 1},
               {1, 0, 0, 1},
               {0, 1, 1, 1}   },
    ['b'] =
        {// 小写b
         {1, 0, 0, 0},
               {1, 0, 0, 0},
               {1, 1, 1, 0},
               {1, 0, 0, 1},
               {1, 0, 0, 1},
               {1, 0, 0, 1},
               {1, 1, 1, 0}   },
    ['c'] =
        {// 小写c
         {0, 0, 0},
               {0, 0, 0},
               {0, 1, 1},
               {1, 0, 0},
               {1, 0, 0},
               {1, 0, 0},
               {0, 1, 1}      },
    ['d'] =
        {// 小写d
         {0, 0, 0, 1},
               {0, 0, 0, 1},
               {0, 1, 1, 1},
               {1, 0, 0, 1},
               {1, 0, 0, 1},
               {1, 0, 0, 1},
               {0, 1, 1, 1}   },
    ['e'] =
        {// 小写e
         {0, 0, 0, 0},
               {0, 0, 0, 0},
               {0, 1, 1, 0},
               {1, 0, 0, 1},
               {1, 1, 1, 1},
               {1, 0, 0, 0},
               {0, 1, 1, 1}   },
    ['f'] =
        {// 小写f
         {0, 1, 1},
               {0, 1, 0},
               {1, 1, 1},
               {0, 1, 0},
               {0, 1, 0},
               {0, 1, 0},
               {0, 1, 0}      },
    ['g'] =
        {// 小写g
         {0, 0, 0, 0},
               {0, 1, 1, 1},
               {1, 0, 0, 1},
               {1, 0, 0, 1},
               {0, 1, 1, 1},
               {0, 0, 0, 1},
               {0, 1, 1, 0}   },
    ['h'] =
        {// 小写h
         {1, 0, 0, 0},
               {1, 0, 0, 0},
               {1, 1, 1, 0},
               {1, 0, 0, 1},
               {1, 0, 0, 1},
               {1, 0, 0, 1},
               {1, 0, 0, 1}   },
    ['i'] =
        {// 小写i
         {1},
               {0},
               {1},
               {1},
               {1},
               {1},
               {1}            },
    ['j'] =
        {// 小写j
         {0, 1},
               {0, 0},
               {0, 1},
               {0, 1},
               {0, 1},
               {0, 1},
               {1, 0}         },
    ['k'] =
        {// 小写k
         {1, 0, 0},
               {1, 0, 0},
               {1, 0, 1},
               {1, 1, 0},
               {1, 1, 0},
               {1, 0, 1},
               {1, 0, 1}      },
    ['l'] =
        {// 小写l
         {1, 0, 0},
               {1, 0, 0},
               {1, 0, 0},
               {1, 0, 0},
               {1, 0, 0},
               {1, 0, 1},
               {1, 1, 0}      },
    ['m'] =
        {// 小写m
         {0, 0, 0, 0, 0},
               {0, 0, 0, 0, 0},
               {1, 1, 0, 1, 0},
               {1, 0, 1, 0, 1},
               {1, 0, 1, 0, 1},
               {1, 0, 1, 0, 1},
               {1, 0, 1, 0, 1}},
    ['n'] =
        {// 小写n
         {0, 0, 0, 0},
               {0, 0, 0, 0},
               {1, 1, 1, 0},
               {1, 0, 0, 1},
               {1, 0, 0, 1},
               {1, 0, 0, 1},
               {1, 0, 0, 1}   },
    ['o'] =
        {// 小写o
         {0, 0, 0, 0},
               {0, 0, 0, 0},
               {0, 1, 1, 0},
               {1, 0, 0, 1},
               {1, 0, 0, 1},
               {1, 0, 0, 1},
               {0, 1, 1, 0}   },
    ['p'] =
        {// 小写p
         {0, 0, 0, 0},
               {0, 0, 0, 0},
               {1, 1, 1, 0},
               {1, 0, 0, 1},
               {1, 1, 1, 0},
               {1, 0, 0, 0},
               {1, 0, 0, 0}   },
    ['q'] =
        {// 小写q
         {0, 0, 0, 0},
               {0, 0, 0, 0},
               {0, 1, 1, 1},
               {1, 0, 0, 1},
               {0, 1, 1, 1},
               {0, 0, 0, 1},
               {0, 0, 0, 1}   },
    ['r'] =
        {// 小写r
         {0, 0, 0},
               {0, 0, 0},
               {1, 0, 1},
               {1, 1, 0},
               {1, 0, 0},
               {1, 0, 0},
               {1, 0, 0}      },
    ['s'] =
        {// 小写s
         {0, 0, 0, 0},
               {0, 0, 0, 0},
               {0, 1, 1, 1},
               {1, 0, 0, 0},
               {0, 1, 1, 0},
               {0, 0, 0, 1},
               {1, 1, 1, 0}   },
    ['t'] =
        {// 小写t
         {0, 1, 0, 0},
               {0, 1, 0, 0},
               {1, 1, 1, 1},
               {0, 1, 0, 0},
               {0, 1, 0, 0},
               {0, 1, 0, 0},
               {0, 1, 1, 1}   },
    ['u'] =
        {// 小写u
         {0, 0, 0, 0},
               {0, 0, 0, 0},
               {1, 0, 0, 1},
               {1, 0, 0, 1},
               {1, 0, 0, 1},
               {1, 0, 0, 1},
               {0, 1, 1, 1}   },
    ['v'] =
        {// 小写v
         {0, 0, 0},
               {0, 0, 0},
               {1, 0, 1},
               {1, 0, 1},
               {1, 0, 1},
               {1, 0, 1},
               {0, 1, 0}      },
    ['w'] =
        {// 小写w
         {0, 0, 0, 0, 0},
               {0, 0, 0, 0, 0},
               {1, 0, 0, 0, 1},
               {1, 0, 1, 0, 1},
               {1, 0, 1, 0, 1},
               {1, 0, 1, 0, 1},
               {0, 1, 0, 1, 0}},
    ['x'] =
        {// 小写x
         {0, 0, 0},
               {0, 0, 0},
               {1, 0, 1},
               {1, 0, 1},
               {0, 1, 0},
               {1, 0, 1},
               {1, 0, 1}      },
    ['y'] =
        {// 小写y
         {0, 0, 0},
               {0, 0, 0},
               {1, 0, 1},
               {1, 0, 1},
               {0, 1, 1},
               {0, 0, 1},
               {1, 1, 0}      },
    ['z'] =
        {// 小写z
         {0, 0, 0},
               {0, 0, 0},
               {1, 1, 1},
               {0, 0, 1},
               {0, 1, 0},
               {1, 0, 0},
               {1, 1, 1}      },

    // 标点符号
    ['!'] =
        {// 感叹号
         {0, 1},
               {0, 1},
               {0, 1},
               {0, 1},
               {0, 1},
               {0, 0},
               {0, 1}         },
    ['.'] =
        {// 句点
         {0},
               {0},
               {0},
               {0},
               {0},
               {0},
               {1}            },
    [','] =
        {// 逗号
         {0, 0},
               {0, 0},
               {0, 0},
               {0, 0},
               {0, 0},
               {0, 1},
               {1, 0}         },
    ['?'] =
        {// 问号
         {0, 1, 1, 0},
               {1, 0, 0, 1},
               {0, 0, 0, 1},
               {0, 0, 1, 0},
               {0, 1, 0, 0},
               {0, 0, 0, 0},
               {0, 1, 0, 0}   },
    ['-'] =
        {// 连字符
         {0, 0, 0},
               {0, 0, 0},
               {0, 0, 0},
               {1, 1, 1},
               {0, 0, 0},
               {0, 0, 0},
               {0, 0, 0}      },
    ['+'] =
        {// 加号
         {0, 0, 0},
               {0, 1, 0},
               {0, 1, 0},
               {1, 1, 1},
               {0, 1, 0},
               {0, 1, 0},
               {0, 0, 0}      },
    [':'] =
        {// 冒号
         {0},
               {1},
               {0},
               {0},
               {0},
               {1},
               {0}            },
    [';'] =
        {// 分号
         {0, 0},
               {0, 1},
               {0, 0},
               {0, 0},
               {0, 0},
               {0, 1},
               {1, 0}         },
    ['('] =
        {// 左括号
         {0, 1},
               {1, 0},
               {1, 0},
               {1, 0},
               {1, 0},
               {1, 0},
               {0, 1}         },
    [')'] =
        {// 右括号
         {1, 0},
               {0, 1},
               {0, 1},
               {0, 1},
               {0, 1},
               {0, 1},
               {1, 0}         },
    ['['] =
        {// 左方括号
         {1, 1},
               {1, 0},
               {1, 0},
               {1, 0},
               {1, 0},
               {1, 0},
               {1, 1}         },
    [']'] =
        {// 右方括号
         {1, 1},
               {0, 1},
               {0, 1},
               {0, 1},
               {0, 1},
               {0, 1},
               {1, 1}         },
    ['<'] =
        {// 小于号
         {0, 0, 1},
               {0, 1, 0},
               {1, 0, 0},
               {1, 0, 0},
               {0, 1, 0},
               {0, 0, 1},
               {0, 0, 0}      },
    ['>'] =
        {// 大于号
         {1, 0, 0},
               {0, 1, 0},
               {0, 0, 1},
               {0, 0, 1},
               {0, 1, 0},
               {1, 0, 0},
               {0, 0, 0}      },
    ['='] =
        {// 等号
         {0, 0, 0},
               {0, 0, 0},
               {1, 1, 1},
               {0, 0, 0},
               {1, 1, 1},
               {0, 0, 0},
               {0, 0, 0}      },
    ['*'] =
        {// 星号
         {0, 0, 0},
               {1, 0, 1},
               {0, 1, 0},
               {1, 1, 1},
               {0, 1, 0},
               {1, 0, 1},
               {0, 0, 0}      },
    ['\''] =
        {// 单引号
         {1},
               {1},
               {0},
               {0},
               {0},
               {0},
               {0}            },
    ['"'] =
        {// 双引号
         {1, 0, 1},
               {1, 0, 1},
               {0, 0, 0},
               {0, 0, 0},
               {0, 0, 0},
               {0, 0, 0},
               {0, 0, 0}      },
    ['\\'] =
        {// 反斜杠
         {1, 0, 0},
               {1, 0, 0},
               {0, 1, 0},
               {0, 1, 0},
               {0, 1, 0},
               {0, 0, 1},
               {0, 0, 1}      },
    ['/'] = {// 正斜杠
             {0, 0, 1},
               {0, 0, 1},
               {0, 1, 0},
               {0, 1, 0},
               {0, 1, 0},
               {1, 0, 0},
               {1, 0, 0}      }
};

#endif // NUMBERS_H
```

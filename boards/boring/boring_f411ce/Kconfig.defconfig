## boards/boring/boring_f411ce/board.yml
```yaml
board:
  name: boring_f411ce
  full_name: Boring F411CE
  vendor: boring
  socs:
    - name: stm32f411xe
```

## boards/boring/boring_f411ce/boring_f411ce_defconfig
```kconfig
# SPDX-License-Identifier: Apache-2.0

# Enable MPU
CONFIG_ARM_MPU=y

# Enable HW stack protection
CONFIG_HW_STACK_PROTECTION=y

# Serial Drivers
CONFIG_SERIAL=y
CONFIG_UART_INTERRUPT_DRIVEN=y
CONFIG_CONSOLE=y
CONFIG_UART_CONSOLE=y

# Enable GPIO
CONFIG_GPIO=y


# for usb cdc acm
CONFIG_STDOUT_CONSOLE=y
CONFIG_UART_LINE_CTRL=y
CONFIG_USB_DEVICE_STACK_NEXT=y
CONFIG_CDC_ACM_SERIAL_INITIALIZE_AT_BOOT=y
CONFIG_CDC_ACM_SERIAL_PID=0x0004
CONFIG_CDC_ACM_SERIAL_PRODUCT_STRING="USBD console sample"


# for display
CONFIG_DISPLAY=y
CONFIG_HEAP_MEM_POOL_SIZE=16384
# CONFIG_FPU=y
```

## boards/fanke/fk750m6_xih6/Kconfig.dconfig
```kconfig
if WIFI_AIROC

choice AIROC_PART
	default CYW43439
endchoice

choice CYW4343W_MODULE
	default CYW4343W_MURATA_1DX
endchoice
# config WHD_DISABLE_SDIO_PULLUP_DURING_SPI_SLEEP
# 	default y

endif # WIFI_AIROC
```

## boards/fanke/fk750m6_xih6/fk750m6_xih6_defconfig
```kconfig
# Copyright (c) zack jiang, Honbo He <hehongbo918@gmail.com>
# SPDX-License-Identifier: Apache-2.0

# Enable MPU
CONFIG_ARM_MPU=y

# Enable HW stack protection
CONFIG_HW_STACK_PROTECTION=y

# Enable UART
CONFIG_SERIAL=y

# Console
CONFIG_CONSOLE=y
CONFIG_UART_CONSOLE=y

# Enable GPIO
CONFIG_GPIO=y


CONFIG_MAIN_STACK_SIZE=4096
CONFIG_SDMMC_STM32_CLOCK_CHECK=n
# CONFIG_COMMON_LIBC_MALLOC_ARENA_SIZE=8192


# CONFIG_SDMMC_STM32_HWFC=y
CONFIG_SD_CMD_TIMEOUT=1000
CONFIG_HEAP_MEM_POOL_SIZE=24576
```

## boards/others/planet_f407ve/Kconfig.defconfig
```kconfig
# black_f407ve board configuration

# Copyright (c) 2020 Intel Corporation
# SPDX-License-Identifier: Apache-2.0

if BOARD_PLANET_F407VE

configdefault NET_L2_ETHERNET
	default y

config SPI_STM32_INTERRUPT
	default y
	depends on SPI

endif # BOARD_PLANET_F407VE
```

## boards/others/planet_f407ve/board.yml
```yaml
board:
  name: planet_f407ve
  full_name: Planet STM32 F407VE Development Board
  vendor: others
  socs:
    - name: stm32f407xx
```

## boards/others/planet_f407ve/planet_f407ve_defconfig
```kconfig
# SPDX-License-Identifier: Apache-2.0

# Enable MPU
CONFIG_ARM_MPU=y

# Enable HW stack protection
CONFIG_HW_STACK_PROTECTION=y

# Enable UART
CONFIG_SERIAL=y

# Console
CONFIG_CONSOLE=y
CONFIG_UART_CONSOLE=y

# Enable GPIO
CONFIG_GPIO=y

# CONFIG_STDOUT_CONSOLE=y
CONFIG_UART_LINE_CTRL=y

CONFIG_USB_DEVICE_STACK_NEXT=y
CONFIG_CDC_ACM_SERIAL_INITIALIZE_AT_BOOT=y
CONFIG_CDC_ACM_SERIAL_PID=0x0004
CONFIG_CDC_ACM_SERIAL_PRODUCT_STRING="USBD console sample"
```

## boards/ruiside/ra8p1_titan/Kconfig.defconfig
```kconfig
# Copyright The Zephyr Project Contributors
# SPDX-License-Identifier: Apache-2.0

if BOARD_RA8P1_TITAN

if DISK_DRIVER_SDMMC

config SD_CMD_TIMEOUT
	default 1000

endif # DISK_DRIVER_SDMMC

configdefault NET_L2_ETHERNET
	default y

# Enable fixed clock for ethernet phy
config CLOCK_CONTROL_FIXED_RATE_CLOCK
	default y if ETH_PHY_DRIVER

# if WIFI_AIROC

# choice AIROC_PART
# 	default CYW43438
# endchoice

# choice CYW43438_MODULE
# 	default CYW43438_AW_CU427_P
# endchoice
# # config WHD_DISABLE_SDIO_PULLUP_DURING_SPI_SLEEP
# # 	default y

# endif # WIFI_AIROC

# if BT

# choice AIROC_PART
# 	default CYW43438
# endchoice

# choice CYW43438_MODULE
# 	default CYW43438_AW_CU427_P
# endchoice
# endif # BT
endif # BOARD_RA8P1_TITAN
```

## west.yml
```yaml
# Copyright (c) 2021 Nordic Semiconductor ASA
# SPDX-License-Identifier: Apache-2.0

manifest:
  self:
    west-commands: scripts/west-commands.yml

  remotes:
    - name: zephyrproject-rtos
      url-base: https://github.com/bricle
    - name: eembc
      url-base: https://github.com/eembc

  projects:
    - name: zephyr
      remote: zephyrproject-rtos
      revision: main
      import:
        # By using name-allowlist we can clone only the modules that are
        # strictly needed by the application.
        name-allowlist:
          - hal_adi
          - cmsis      # required by the ARM port
          - cmsis_6
          - hal_nordic # required by the custom_plank board (Nordic based)
          - hal_stm32  # required by the nucleo_f302r8 board (STM32 based)
          - hal_renesas
          - picolibc
          - segger
          - mcuboot
          - mbedtls
          - tf-psa-crypto
          - net-tools
          - mldsa-native
          - littlefs
          - fatfs
          - lvgl
          - hal_nxp
          - hal_infineon
          - zcbor
          - hal_sifli
          - hostap
    - name: coremark
      remote: eembc
      path: modules/benchmark/coremark
      revision: d5fad6bd094899101a4e5fd53af7298160ced6ab
      groups:
        - benchmark
```

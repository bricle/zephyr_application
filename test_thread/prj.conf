## prj.conf
```kconfig
CONFIG_GPIO=y
#CONFIG_LOG=y
CONFIG_PRINTK=y
CONFIG_TIMESLICING=y
CONFIG_TIMESLICE_SIZE=10
CONFIG_TIMESLICE_PRIORITY=0
```

## src/main.c
```c
/*
 * Copyright (c) 2016 Intel Corporation
 *
 * SPDX-License-Identifier: Apache-2.0
 */

#include <stdio.h>
#include <zephyr/kernel.h>
#include <zephyr/drivers/gpio.h>
#include "zephyr/logging/log.h"
#include "zephyr/sys/printk.h"

/* 1000 msec = 1 sec */
#define SLEEP_TIME_MS   1000

/* The devicetree node identifier for the "led0" alias. */
#define LED0_NODE DT_ALIAS(led0)

/*
 * A build error on this line means your board is unsupported.
 * See the sample documentation for information on how to fix this.
 */
static const struct gpio_dt_spec led = GPIO_DT_SPEC_GET(LED0_NODE, gpios);
LOG_MODULE_REGISTER(blinking, LOG_LEVEL_INF);

void task1_fun(void) {
    while (1) {
        // LOG_INF("Task1\n");
        printk("Task1\n");
        k_busy_wait(500000);
        // k_msleep(1000);
    }
}

void task2_fun(void) {
    while (1) {
        // LOG_INF("Task2\n");
        printk("Task2\n");
        // k_msleep(1000);
        k_busy_wait(500000);
    }
}

K_THREAD_DEFINE(task1, 512, task1_fun, NULL, NULL, NULL, 2, 0, 0);
K_THREAD_DEFINE(task2, 512, task2_fun, NULL, NULL, NULL, 2, 0, 0);

// int main(void) {
//     int ret;
//     bool led_state = true;

//     if (!gpio_is_ready_dt(&led)) {
//         return 0;
//     }

//     ret = gpio_pin_configure_dt(&led, GPIO_OUTPUT_ACTIVE);
//     if (ret < 0) {
//         return 0;
//     }

//     while (1) {
//         ret = gpio_pin_toggle_dt(&led);
//         if (ret < 0) {
//             return 0;
//         }

//         led_state = !led_state;
//         LOG_INF("LED state: %s\n", led_state ? "ON" : "OFF");
//         k_msleep(SLEEP_TIME_MS);
//     }
//     return 0;
// }
```
